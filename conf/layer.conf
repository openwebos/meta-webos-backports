## conf/layer.conf
```bitbake
# Copyright (c) 2013 LG Electronics, Inc.

# We have conf and classes directories => add to BBPATH
BBPATH .= ":${LAYERDIR}"

# We have recipes-* directories => add to BBFILES
BBFILES += "${LAYERDIR}/recipes-*/*/*.bb \
            ${LAYERDIR}/recipes-*/*/*.bbappend"

BBFILE_COLLECTIONS += "meta-webos-backports"
BBFILE_PATTERN_meta-webos-backports := "^${LAYERDIR}/"
BBFILE_PRIORITY_meta-webos-backports = "9"
```
